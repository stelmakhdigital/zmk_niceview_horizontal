## boards/shields/display_view/Kconfig.shield
```kconfig
# Copyright (c) 2022 The ZMK Contributors
# SPDX-License-Identifier: MIT

config SHIELD_DISPLAY_VIEW_HORIZONTAL
    def_bool $(shields_list_contains,display_view_horizontal)
```
